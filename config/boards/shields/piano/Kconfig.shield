## config/boards/shields/piano/Kconfig.shield
```kconfig
# Copyright (c) 2020 The ZMK Contributors
# SPDX-License-Identifier: MIT

config SHIELD_PIANO_NORM_LEFT
	def_bool $(shields_list_contains,piano_norm_left)

config SHIELD_PIANO_NORM_RIGHT
	def_bool $(shields_list_contains,piano_norm_right)
	
```
